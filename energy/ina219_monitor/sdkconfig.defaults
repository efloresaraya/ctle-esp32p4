## energy/ina219_monitor/sdkconfig.defaults
```kconfig
# Managed by Enki ESP Environment
CONFIG_ESPTOOLPY_FLASHSIZE_4MB=y
CONFIG_PARTITION_TABLE_SINGLE_APP=y
CONFIG_LOG_DEFAULT_LEVEL_INFO=y
CONFIG_LOG_DEFAULT_LEVEL=3
CONFIG_USJ_ENABLE_USB_SERIAL_JTAG=y
# CONFIG_ETH_ENABLED is not set
# CONFIG_ETH_USE_ESP32_EMAC is not set
# CONFIG_ETH_USE_SPI_ETHERNET is not set
# CONFIG_ESP_HOST_WIFI_ENABLED is not set
```

## firmware/sdkconfig.defaults
```kconfig
# Managed by Enki ESP Environment
# Board: ESP32-P4 Nano — 32MB PSRAM, 16MB Flash

# --- CPU frequency: 400 MHz (HP core max) ---
CONFIG_ESP_DEFAULT_CPU_FREQ_MHZ=400
CONFIG_ESP_DEFAULT_CPU_FREQ_MHZ_400=y

# --- Chip revision ---
CONFIG_ESP32P4_SELECTS_REV_LESS_V3=y
CONFIG_ESP32P4_REV_MIN_100=y

# --- Flash: 16MB ---
CONFIG_ESPTOOLPY_FLASHSIZE_16MB=y
CONFIG_ESPTOOLPY_FLASHSIZE="16MB"

# --- PSRAM: 32MB QSPI ---
CONFIG_SPIRAM=y
CONFIG_SPIRAM_MODE_QUAD=y
CONFIG_SPIRAM_TYPE_AUTO=y
CONFIG_SPIRAM_SIZE=-1
CONFIG_SPIRAM_SPEED_80M=y
CONFIG_SPIRAM_MEMTEST=y
CONFIG_SPIRAM_USE_MALLOC=y
CONFIG_SPIRAM_MALLOC_ALWAYSINTERNAL=16384

# --- Partition table ---
CONFIG_PARTITION_TABLE_CUSTOM=y
CONFIG_PARTITION_TABLE_CUSTOM_FILENAME="partitions.csv"

# --- Logging ---
CONFIG_LOG_DEFAULT_LEVEL_INFO=y
CONFIG_LOG_DEFAULT_LEVEL=3

# --- USB Serial JTAG (debug port on P4 Nano) ---
CONFIG_USJ_ENABLE_USB_SERIAL_JTAG=y

# --- Disable unused peripherals ---
# CONFIG_ETH_ENABLED is not set
# CONFIG_ETH_USE_ESP32_EMAC is not set
# CONFIG_ETH_USE_SPI_ETHERNET is not set
# CONFIG_ESP_HOST_WIFI_ENABLED is not set
```
